#include "KyamiKBD.dtsi"

&kscan0 {
    row-gpios = <&gpio0 2 (GPIO_ACTIVE_LOW)>
              , <&gpio0 3 (GPIO_ACTIVE_LOW)>
              , <&gpio0 28 (GPIO_ACTIVE_LOW)>
              , <&gpio0 29 (GPIO_ACTIVE_LOW)>;

    col-gpios = <&gpio0 4 (GPIO_ACTIVE_LOW)>
              , <&gpio0 5 (GPIO_ACTIVE_LOW)>
              , <&gpio1 11 (GPIO_ACTIVE_LOW)>
              , <&gpio1 12 (GPIO_ACTIVE_LOW)>
              , <&gpio1 13 (GPIO_ACTIVE_LOW)>
              , <&gpio1 14 (GPIO_ACTIVE_LOW)>
              , <&gpio1 15 (GPIO_ACTIVE_LOW)>;
};

&uart0 {
    status = "disabled";
};
